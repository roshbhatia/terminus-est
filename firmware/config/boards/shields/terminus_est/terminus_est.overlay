/*
 * Copyright (c) 2024 The ZMK Contributors
 *
 * SPDX-License-Identifier: MIT
 */

#include "terminus_est.dtsi"

&kscan0 {
	col-gpios
		= <&pro_micro 0 GPIO_ACTIVE_HIGH>   // COL0  (GP0)
		, <&pro_micro 1 GPIO_ACTIVE_HIGH>   // COL1  (GP1)
		, <&pro_micro 2 GPIO_ACTIVE_HIGH>   // COL2  (GP2)
		, <&pro_micro 3 GPIO_ACTIVE_HIGH>   // COL3  (GP3)
		, <&pro_micro 4 GPIO_ACTIVE_HIGH>   // COL4  (GP4)
		, <&pro_micro 5 GPIO_ACTIVE_HIGH>   // COL5  (GP5)
		, <&pro_micro 6 GPIO_ACTIVE_HIGH>   // COL6  (GP6)
		, <&pro_micro 7 GPIO_ACTIVE_HIGH>   // COL7  (GP7)
		, <&pro_micro 8 GPIO_ACTIVE_HIGH>   // COL8  (GP8)
		, <&pro_micro 9 GPIO_ACTIVE_HIGH>   // COL9  (GP9)
		, <&pro_micro 16 GPIO_ACTIVE_HIGH>  // COL10 (GP16)
		, <&pro_micro 17 GPIO_ACTIVE_HIGH>  // COL11 (GP17)
		, <&pro_micro 18 GPIO_ACTIVE_HIGH>  // COL12 (GP18)
		, <&pro_micro 19 GPIO_ACTIVE_HIGH>  // COL13 (GP19)
		, <&pro_micro 20 GPIO_ACTIVE_HIGH>  // COL14 (GP20)
		, <&pro_micro 21 GPIO_ACTIVE_HIGH>  // COL15 (GP21)
		, <&pro_micro 22 GPIO_ACTIVE_HIGH>  // COL16 (GP22)
		, <&pro_micro 26 GPIO_ACTIVE_HIGH>  // COL17 (GP26)
		, <&pro_micro 27 GPIO_ACTIVE_HIGH>  // COL18 (GP27)
		, <&pro_micro 28 GPIO_ACTIVE_HIGH>  // COL19 (GP28)
		;
};