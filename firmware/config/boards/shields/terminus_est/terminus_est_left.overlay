/*
 * Copyright (c) 2024 The ZMK Contributors
 *
 * SPDX-License-Identifier: MIT
 */

#include "terminus_est.dtsi"

&kscan0 {
	col-gpios
		= <&pro_micro 0 GPIO_ACTIVE_HIGH>
		, <&pro_micro 1 GPIO_ACTIVE_HIGH>
		, <&pro_micro 2 GPIO_ACTIVE_HIGH>
		, <&pro_micro 3 GPIO_ACTIVE_HIGH>
		, <&pro_micro 4 GPIO_ACTIVE_HIGH>
		, <&pro_micro 5 GPIO_ACTIVE_HIGH>
		, <&pro_micro 6 GPIO_ACTIVE_HIGH>
		, <&pro_micro 7 GPIO_ACTIVE_HIGH>
		, <&pro_micro 8 GPIO_ACTIVE_HIGH>
		, <&pro_micro 9 GPIO_ACTIVE_HIGH>
		, <&pro_micro 20 GPIO_ACTIVE_HIGH>
		, <&pro_micro 21 GPIO_ACTIVE_HIGH>
		;
};