## firmware/config/boards/shields/terminus_est/Kconfig.defconfig
```kconfig
# Copyright (c) 2024 The ZMK Contributors
# SPDX-License-Identifier: MIT

if SHIELD_TERMINUS_EST_LEFT

config ZMK_KEYBOARD_NAME
	default "Terminus Est"

config ZMK_SPLIT_ROLE_CENTRAL
	default y

endif

if SHIELD_TERMINUS_EST_LEFT || SHIELD_TERMINUS_EST_RIGHT

config ZMK_SPLIT
	default y

endif
```

## firmware/config/boards/shields/terminus_est/Kconfig.shield
```kconfig
# Copyright (c) 2024 The ZMK Contributors
# SPDX-License-Identifier: MIT

config SHIELD_TERMINUS_EST_LEFT
	def_bool $(shields_list_contains,terminus_est_left)

config SHIELD_TERMINUS_EST_RIGHT
	def_bool $(shields_list_contains,terminus_est_right)
```
