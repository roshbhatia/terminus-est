/*
 * Copyright (c) 2024 The ZMK Contributors
 *
 * SPDX-License-Identifier: MIT
 */

#include "terminus_est.dtsi"

&default_transform {
	col-offset = <10>;
};

&kscan0 {
	col-gpios
		= <&pro_micro 16 GPIO_ACTIVE_HIGH>
		, <&pro_micro 17 GPIO_ACTIVE_HIGH>
		, <&pro_micro 18 GPIO_ACTIVE_HIGH>
		, <&pro_micro 19 GPIO_ACTIVE_HIGH>
		, <&pro_micro 20 GPIO_ACTIVE_HIGH>
		, <&pro_micro 21 GPIO_ACTIVE_HIGH>
		, <&pro_micro 22 GPIO_ACTIVE_HIGH>
		, <&pro_micro 26 GPIO_ACTIVE_HIGH>
		, <&pro_micro 27 GPIO_ACTIVE_HIGH>
		, <&pro_micro 28 GPIO_ACTIVE_HIGH>
		;
};